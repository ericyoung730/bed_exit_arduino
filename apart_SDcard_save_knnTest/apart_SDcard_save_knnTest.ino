#include <avr/pgmspace.h>
#include "new_pulseIn.h"
#include "Direction_Detect.h"
#include "databaseStruct.h"
#include <SPI.h>
#include <SD.h>
#include <DS3231.h>
DS3231  rtc(SDA, SCL);  //SDA = A4 SCL = A5
Time t;

float feat[7] = {0};
resultVector resultDistance[K_OF_KNN+1];
const float ref_feat[][7] PROGMEM= {
{3.0,53.6,2.2,99.0,79.8,15.2,6.1},
{3.0,100.0,-0.7,77.0,89.6,46.8,46.8},
{4.0,73.4,-3.3,111.0,77.5,20.7,11.7},
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{5.0,69.5,-0.9,111.0,79.3,28.8,12.6}
};
const byte lable[AC_NUMBER] PROGMEM={
1,
2,
1,
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1,
1
};
byte printAC = 0;
byte Election[AC_TYPE] = {0};
int max = 0;
bool action_flag=0;
bool action_end_flag=0;
const int chipSelect = 10; //CS = 10
String dataString = "";
String fileName = "";
extern volatile uint16_t US1_TIME;
extern volatile uint16_t US2_TIME;
unsigned long pretime=0;
unsigned long interval=20000;
extern int save_switch = 1;  // 1 for stop save data ;0 for start save data
int button = 1;  // 1 for stop save data ;0 for start save data
bool writing=false; 

void setup() {
  rtc.begin();
  Serial.begin(115200);
  TIMER1_Init();
 // rtc.setTime(15, 58,0 );     // Set the time to 12:00:00 (24hr format)
  pinMode(9, OUTPUT);    //output reset
  pinMode(4, OUTPUT);    //trig2
  pinMode(5, OUTPUT);    //trig1 
  pinMode(2, INPUT);     //echo1
  pinMode(3, INPUT);     //echo2  
  pinMode(8,INPUT_PULLUP);  //pullup pin8
  attachInterrupt(0, ISR_US1, FALLING);
  attachInterrupt(1, ISR_US2, FALLING);

  digitalWrite(9,HIGH);

  delay(2000);
  ////////////////check SD card module//////////////////
  if (!SD.begin(chipSelect)) {
    Serial.println(F("Card failed, or not present"));
    delay(2000);
    // don't do anything more:
     for(int i=0;i<7;i++){
    Serial.println(pgm_read_float(&(ref_feat[0][i])));
    Serial.println(lable[0]);
  }
    return;
  }
  Serial.println(F("card initialized."));
  delay(2000);
  Serial.println(F("card initialized."));

 
  //////////////////////////////////////////////////////
 
}
static inline void print_Serial_Plotter_nofiltered()
{
 /* Serial.print(US1_TIME);
  Serial.print(",");
  Serial.print(US2_TIME); 
  Serial.print(",");*/
   dataString=String(US1_TIME);
    dataString += ",";
     dataString +=String(US2_TIME);
}
void knnElection()
{
  for(int i = 0;i < AC_NUMBER;i++){
    float compare_feat[7]={0};
    for(int j=0;j<7;j++){
      compare_feat[j]=pgm_read_float(&(ref_feat[i][j]));
    }
     
     if(i>=K_OF_KNN){
      resultDistance[7].result = EulerDistance(feat,compare_feat);
     resultDistance[7].Type = pgm_read_byte(&(lable[i]));
     bubbleSort(resultDistance);
     }
     else{
      resultDistance[i].result = EulerDistance(feat,compare_feat);
     resultDistance[i].Type = pgm_read_byte(&(lable[i]));
     }
     /*Serial.print(resultDistance[i].result);
     Serial.print(",");
     Serial.println(resultDistance[i].Type);*/
  }
   //bubbleSort(resultDistance);
  for(int i = 0;i < K_OF_KNN;i++){
     Serial.print(resultDistance[i].result);
     Serial.print(",");
     Serial.println(resultDistance[i].Type);
  }
  
      // if have K value do KNN
      //注意 K 最好是奇數,以免造成平手問題,導致傳出兩種數值
      //讀取前K個短的距離的群集,並儲存票數
      Election[0] = 0;
      Election[1] = 0;
      Election[2] = 0; 
      
        for(int i = 0;i < K_OF_KNN;i++){
        
        switch(resultDistance[i].Type){
          
        case 1:
          Election[0] = Election[0]+1;
          break;
        case 2:
          Election[1] = Election[1]+1;
          break;
        case 3:
          Election[2] = Election[2]+1;
          break;
          /*case 4:
          Election[3]++;
          break;*/
        default:
          break;
        }
      }
       
      max = Election[0];
      printAC = 1;
      //找出最多票的群集No.
      for(int i = 1;i < AC_TYPE;i++){
        
        if(Election[i] > max){
          
          max = Election[i];
          printAC = i+1;    //RealTimeAC.ClusterType
        }
        
      }
      
      Serial.println(printAC); 
}
void loop() {
  if(millis()-pretime>interval)
  {
    pretime=millis();
    digitalWrite(9,LOW);
    delay(100);
    //Serial.print("here");
    digitalWrite(9,HIGH);
  } 
  if(digitalRead(8)==0){
    save_switch=!save_switch;
    delay(200);
  }
  
  //save_switch = digitalRead(8); //read switch
                //read US data
  //A_pulseIn_filter();
  //curtime=millis();
  
  t=rtc.getTime();
 /* Serial.print(int(t.hour));
  Serial.print(":");
  Serial.print(int(t.min));
  Serial.print(":");
  Serial.println(int(t.sec));*/
  //delay(1000);
  //print_Serial_Plotter_nofiltered();
  if(actionEndflag==1)
  {
    save_switch=1;
  }
 if(save_switch){
  writing=false;
  actionEndflag=0;
 }  
 else if(int(t.min)%10==0){
      if (int(t.sec)==0){
          t=rtc.getTime();
          fileName=String(t.hour);
          fileName+=String("_");
          fileName+=String(t.min);
          fileName+=String("_");
          fileName+=String(t.sec);
          fileName.concat(".txt");
          Serial.println(fileName);
          }
          //Serial.println(int(t.min));
          //Serial.println(int(t.sec));
          
      char Filename[fileName.length()+1];
      fileName.toCharArray(Filename,sizeof(Filename));
      writing=true;
      File dataFile = SD.open(Filename, FILE_WRITE);
    uint16_t US1_TIME_filtered=0;
    uint16_t US2_TIME_filtered=0;
    int US_TIME_diff=0;
    long movingavg_avg=0;
    float movingavg_avg_normalize=0;
    float US_TIME_diff_normal=0;
    new_pulseIn();
    print_Serial_Plotter_nofiltered();
    US1_TIME_filtered=max1_filter(US1_TIME);
    US2_TIME_filtered=max2_filter(US2_TIME);
    US_TIME_diff=US_diff(US1_TIME_filtered,US2_TIME_filtered);
    
    movingavg_avg=US_movingavg(US_TIME_diff);
    
    if(action_flag==0){
      if(check_act(movingavg_avg)){
      action_flag=1;
      }
    }
    else if(action_flag){
      US_TIME_diff_normal=US_normalize(US_TIME_diff);
      movingavg_avg_normalize=US_normalize(movingavg_avg);
      length_cal(US1_TIME_filtered,US2_TIME_filtered);
      zero_cross_count(movingavg_avg_normalize);
      area_cal(US_TIME_diff_normal,movingavg_avg_normalize);
      if(check_end(movingavg_avg)){
        features_put_and_reset();
        action_flag=0;
        actionEndflag=1;
      }
    }
      if (dataFile) {
          dataFile.println(dataString);
          dataFile.close();
      // print to the serial port too:
      //Serial.println(dataString);
      }
 }
 else{ 
    if(writing==false){
       t=rtc.getTime();
       fileName=String(t.hour);
       fileName+=String("_");
       fileName+=String(t.min);
       fileName+=String("_");
       fileName+=String("_");
       fileName+=String(t.sec);
       
       fileName.concat(".txt");
       Serial.println(fileName);
    }
    char Filename[fileName.length()+1];
    fileName.toCharArray(Filename,sizeof(Filename));
    writing=true;
    File dataFile = SD.open(Filename, FILE_WRITE);
    uint16_t US1_TIME_filtered=0;
    uint16_t US2_TIME_filtered=0;
    int US_TIME_diff=0;
    long movingavg_avg=0;
    float movingavg_avg_normalize=0;
    float US_TIME_diff_normal=0;
    new_pulseIn();
    print_Serial_Plotter_nofiltered();
    US1_TIME_filtered=max1_filter(US1_TIME);
    US2_TIME_filtered=max2_filter(US2_TIME);
   /* Serial.print(US1_TIME_filtered);
    Serial.print(",");
    Serial.print(US2_TIME_filtered); 
    Serial.print(",");*/
    US_TIME_diff=US_diff(US1_TIME_filtered,US2_TIME_filtered);
    /*Serial.print(US_TIME_diff);
    Serial.print(",");*/
    movingavg_avg=US_movingavg(US_TIME_diff);
    /*Serial.print(movingavg_avg); 
    Serial.println();*/
    if(action_flag==0){
      if(check_act(movingavg_avg)){
      action_flag=1;
      }
    }
    else if(action_flag){
      US_TIME_diff_normal=US_normalize(US_TIME_diff);
      movingavg_avg_normalize=US_normalize(movingavg_avg);
      Serial.print(US_TIME_diff_normal);
      Serial.print(",");
      Serial.print(movingavg_avg_normalize);
      Serial.print(",");
      Serial.println();
      length_cal(US1_TIME_filtered,US2_TIME_filtered);
      zero_cross_count(movingavg_avg_normalize);
      area_cal(US_TIME_diff_normal,movingavg_avg_normalize);
      if(check_end(movingavg_avg)){
        action_flag=0;
        features_put_and_reset();
        actionEndflag=1;
      }
    }
    if(actionEndflag==1){
      for(int i=0;i<7;i++){
     //   feat[i]=knn_feature[i];
        Serial.print(feat[i]);
        Serial.print(" ");
      }
      Serial.println();
     knnElection();
      actionEndflag=0;
    }
    
    if (dataFile) {
       dataFile.println(dataString);
       dataFile.close();
       // print to the serial port too:
       //Serial.println(dataString);
    }
 }
  
}
