
#include <Wire.h>  
#include <Adafruit_GFX.h>  
#include <Adafruit_SSD1306.h>  
#define OLED_RESET -1  
Adafruit_SSD1306 display(OLED_RESET);  
  
#define NUMFLAKES 10  
#define XPOS 0  
#define YPOS 1  
#define DELTAY 2  
  
  
#define LOGO16_GLCD_HEIGHT 16  
#define LOGO16_GLCD_WIDTH  16  
  
#define imageWidth 96  
#define imageHeight 64  
  
int count = 0;  
long timer1=0;  
static const unsigned char PROGMEM logo16_glcd_bmp[] =  
{ B00000000, B11000000,  
  B00000001, B11000000,  
  B00000001, B11000000,  
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  B00000000, B00110000 };  
  
const unsigned char PROGMEM low_power [] = {
0x00, 0x00, 0x00, 0x00, 0x00, 0x00, 0x00, 0x00, 0x00, 0x00, 0x00, 0x00, 0x00, 0x00, 0x00, 0x00,
0x00, 0x01, 0xFF, 0xFF, 0xFF, 0xFF, 0xFF, 0xFF, 0xFF, 0xFF, 0xFF, 0xFF, 0xF0, 0x00, 0x00, 0x00,
0x00, 0x3F, 0xFF, 0xFF, 0xFF, 0xFF, 0xFF, 0xFF, 0xFF, 0xFF, 0xFF, 0xFF, 0xFF, 0xC0, 0x00, 0x00,
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0x00, 0x00, 0x00, 0x00, 0x00, 0x00, 0x00, 0x00, 0x00, 0x00, 0x00, 0x00, 0x00, 0x00, 0x00, 0x00
};

  
void setup() {  
  Serial.begin(115200);
  pinMode(A1,INPUT_PULLUP);
  pinMode(A2,INPUT_PULLUP);
  // put your setup code here, to run once:  
   // SSD1306_SWITCHCAPVCC = generate display voltage from 3.3V internally
  if(!display.begin(SSD1306_SWITCHCAPVCC, 0x3C)) { // Address 0x3C for 128x32
    Serial.println(F("SSD1306 allocation failed"));
    for(;;); // Don't proceed, loop forever
  }
  // init done  
  display.setTextColor(WHITE);  
  // Show image buffer on the display hardware.  
  // Since the buffer is intialized with an Adafruit splashscreen  
  // internally, this will display the splashscreen.  
  display.display();  
  delay(2000);  
  
  // Clear the buffer.  
  display.clearDisplay();  
  display.drawBitmap(0, 0,  low_power , 128, 32, 1);  
    
  display.display(); 
}  
  
void loop() {  
//  if(millis()==20000)
//  {
//  display.clearDisplay();
//  display.display();
//  } 
  if(digitalRead(A1)==LOW)
  {
    if(millis()-timer1>500)
    {
      timer1=millis();
    Serial.println("A1 pressed");
    display.drawBitmap(0, 0,  low_power , 128, 32, 1);  
    
    display.display(); 
    }
  }
  else if(digitalRead(A2)==LOW)
  {
     if(millis()-timer1>500)
    {
      timer1=millis();
          Serial.println("A2 pressed");
    display.clearDisplay(); 
    
    display.display(); 
    }

  }
    
  
  
}  
